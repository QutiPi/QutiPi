## customise/muelectronics-10000-actions/conf/layer.conf
```bitbake
# Append conf directory to BBPATH
BBPATH .= ":${LAYERDIR}"

# Include local config file
include ${LAYERDIR}/conf/local.conf

# Add recipes
BBFILES += " \
    ${LAYERDIR}/recipes*/*/*.bb \
    ${LAYERDIR}/recipes*/*/*.bbappend \
    ${LAYERDIR}/recipes*/*/*/*.bb \
    ${LAYERDIR}/recipes*/*/*/*.bbappend \
"

BBFILE_COLLECTIONS += "customise"
BBFILE_PATTERN_customise = "^${LAYERDIR}/"
BBFILE_PRIORITY_customise = "4"
```

## customise/muelectronics-10000-actions/conf/local.conf
```bitbake
# Addtional recipts
IMAGE_INSTALL_append += "application \
                        "
```

## hardware/rpi-cm3-v1-full/conf/layer.conf
```bitbake
# Append conf directory to BBPATH
BBPATH .= ":${LAYERDIR}"

# Include local config file
include ${LAYERDIR}/conf/local.conf

# Addtional recipts
# @TODO add lmsensors
IMAGE_INSTALL += "load-modules \
                 "

# Add recipes
BBFILES += " \
    ${LAYERDIR}/recipes*/*/*.bb \
    ${LAYERDIR}/recipes*/*/*.bbappend \
    ${LAYERDIR}/recipes*/*/*/*.bb \
    ${LAYERDIR}/recipes*/*/*/*.bbappend \
"

BBFILE_COLLECTIONS += "hardware"
BBFILE_PATTERN_hardware = "^${LAYERDIR}/"
BBFILE_PRIORITY_hardware = "4"
```

## hardware/rpi-cm3-v1-full/conf/local.conf
```bitbake
# Addtional recipts
IMAGE_INSTALL_append += "rtc \
                         networkd \
                        "

# Load modules 
KERNEL_MODULE_AUTOLOAD += "i2c-dev bcm2708_wdog rtc-1307"

# Add any addtion features (@todo add vc4graphics)
# MACHINE_FEATURES += "pitft"

# Enable UART
ENABLE_UART = "1"

# Enable SPI
ENABLE_SPI_BUS = "1"

# Enable i2c
ENABLE_I2C = "1"

# Enable video cam support
VIDEO_CAMERA = "1"





# Configure 'static' or 'dhcp' interface
ETHERNET_INTERFACE = "eth0"
ETHERNET_TYPE = "static"
ETHERNET_MAC = "32:23:eb:76:e1:45"


# Set static IP
ETHERNET_IP = "130.88.237.210"
ETHERNET_NETMASK = "24"
ETHERNET_BROADCAST = "130.88.237.255"
ETHERNET_GATEWAY = "130.88.237.250"
ETHERNET_NAMESERVERS = "130.88.13.7"
```

## packages/raspberrypi/conf/layer.conf
```bitbake
# Append conf directory to BBPATH
BBPATH .= ":${LAYERDIR}"

# Add recipes
BBFILES += " \
    ${LAYERDIR}/recipes*/*/*.bb \
    ${LAYERDIR}/recipes*/*/*.bbappend \
    ${LAYERDIR}/recipes*/*/*/*.bb \
    ${LAYERDIR}/recipes*/*/*/*.bbappend \
"

BBFILE_COLLECTIONS += "qutipi_rpi"
BBFILE_PATTERN_qutipi_rpi := "^${LAYERDIR}/"
BBFILE_PRIORITY_qutipi_rpi = "1"
```

## src/conf/bblayers.conf.sample
```bitbake
# POKY_BBLAYERS_CONF_VERSION is increased each time build/conf/bblayers.conf
# changes incompatibly
POKY_BBLAYERS_CONF_VERSION = "2"

# Include the local config file to access variables
include conf/local.conf

BBPATH = "${TOPDIR}"
BBFILES ?= ""
BSPDIR := "${@os.path.abspath(os.path.dirname(d.getVar('FILE', True)) + '/../..')}"

# Include layers
# vendor/meta-mingw
BBLAYERS ?= " \
  ${BSPDIR}/vendor/poky/meta \
  ${BSPDIR}/vendor/poky/meta-poky \
  ${BSPDIR}/vendor/meta-openembedded/meta-oe \
  ${BSPDIR}/vendor/meta-openembedded/meta-python \
  ${BSPDIR}/vendor/meta-openembedded/meta-networking \
  ${BSPDIR}/vendor/meta-openembedded/meta-initramfs \
  ${BSPDIR}/vendor/meta-openembedded/meta-multimedia \
  ${BSPDIR}/vendor/meta-openembedded/meta-perl \
  ${BSPDIR}/vendor/meta-raspberrypi \
  ${BSPDIR}/vendor/meta-mender/meta-mender-core \
  ${BSPDIR}/vendor/meta-mender/meta-mender-raspberrypi \
  ${BSPDIR}/vendor/meta-security \
  ${BSPDIR}/vendor/meta-mingw \
  ${BSPDIR}/vendor/meta-qt5 \
  ${BSPDIR}/src \
  ${BSPDIR}/packages/${PACKAGE} \
  ${BSPDIR}/customise/${CUSTOMISE} \
  ${BSPDIR}/hardware/${HARDWARE} \
"
```

## src/conf/distro/hardware/raspberrypi/raspberrypi-cm3.conf
```bitbake
include conf/distribution/hardware/raspberrypi/raspberrypi.conf

DEPLOY_HARDWARE_NAME = "Raspberry Pi 3"

# Set GPU Memory
GPU_MEM_256 = "1"
```

## src/conf/distro/include/raspberrypi-cm3.conf
```bitbake
include conf/distro/include/raspberrypi.inc

DEPLOY_HARDWARE_NAME = "Raspberry Pi CM3"

# Set GPU Memory
GPU_MEM_256 = "1"
```

## src/conf/distro/include/raspberrypi.inc
```bitbake
# Set the output image file type 
IMAGE_FSTYPES += "tar.xz"

# Add any addtion features (@todo add vc4graphics)
# MACHINE_FEATURES += "pitft"

# Enable UART
ENABLE_UART = "1"

# Enable SPI
ENABLE_SPI_BUS = "1"

# Enable i2c
ENABLE_I2C = "1"

# Enable video cam support
VIDEO_CAMERA = "1"

# Disable pi logo on boot
DISABLE_RPI_BOOT_LOGO = "1"
```

## src/conf/distro/qutipi.conf
```bitbake
# Modify the default poky config
include conf/distro/poky.conf

# Rename distro
DISTRO = "qutipi"
DISTRO_NAME = "Qt + Pi = QutiPi"
DISTRO_CODENAME = "QutiPi"

# Set the SDK naming convention
SDK_VERSION := "${DISTRO_VERSION}"
SDK_MACHINE = "${@d.getVar('SDKMACHINE', True) or '${SDK_ARCH}'}"
SDK_NAME = "${DISTRO}-${SDK_MACHINE}-${IMAGE_BASENAME}"
TOOLCHAIN_OUTPUTNAME = "${SDK_NAME}-${MACHINE}"


# Whos maintaining the layer atm?
MAINTAINER = "Sam Mottley <sam.mottley@manchester.ac.uk>"

# The default is 4.9
# PREFERRED_VERSION_linux-raspberrypi = "4.14.%"

# Set the default output image file type (note: maybe include tar.bz2 + iso)
# IMAGE_FSTYPES = "tar.xz"

# Splash screen
SPLASH = "psplash-customise"

# Set the kernal image type
KERNEL_IMAGETYPE = "zImage"

# Incude distro features
DISTRO_FEATURES += " systemd splash ext2 pam opengl usbhost gstreamer"

# Remove feature that wont be used
DISTRO_FEATURES_DEFAULT_remove = "pcmcia pci x11"
DISTRO_FEATURES_BACKFILL_CONSIDERED = "pulseaudio sysvinit"

# Set the run time init manager
VIRTUAL-RUNTIME_init_manager = "systemd"

# Remove all SysVinit scripts
VIRTUAL-RUNTIME_initscripts = ""

# Set proferred prodvider for device manager to systemd
PREFERRED_PROVIDER_udev ?= "systemd"
PREFERRED_PROVIDER_udev-utils ?= "systemd"

# Set preferred provider for jpeg
PREFERRED_PROVIDER_jpeg ?= "libjpeg-turbo"
PREFERRED_PROVIDER_jpeg-native ?= "libjpeg-turbo-native"

# Disable SHA validation for branch
QT_MODULE_BRANCH_PARAM = "nobranch=1"

# Add a default package manager
IMAGE_FEATURES += "package-management"
PACKAGE_CLASSES ?= "package_ipk"

# Shared image classes (none atm)
IMAGE_CLASSES += ""
USER_CLASSES = "buildstats image-mklibs image-prelink"

# Include the addtional machine config info 
include ../packages/${PACKAGE}/conf/include/${MACHINE}.conf
```

## src/conf/layer.conf
```bitbake
# We have a conf and classes directory, add to BBPATH
BBPATH .= ":${LAYERDIR}"

# Add the main recipes directory
BBFILES += "${LAYERDIR}/recipes/*/*.bb \
            ${LAYERDIR}/recipes/*/*.bbappend \
            ${LAYERDIR}/recipes/recipes-*/*/*.bb \
            ${LAYERDIR}/recipes/recipes-*/*/*.bbappend \
            ${LAYERDIR}/images/*.bb \
            ${LAYERDIR}/recipes/${ADDON}-addons/recipes-*/*/*.bbappend\
            ${LAYERDIR}/recipes/${ADDON}-addons/recipes-*/*/*.bb\
"

BBFILE_COLLECTIONS += "qutipi"
BBFILE_PATTERN_qutipi = "^${LAYERDIR}/"
BBFILE_PRIORITY_qutipi = "5"
LAYERVERSION_qutipi = "3"
```

## src/conf/local.conf.sample
```bitbake
# Customisation package << Suggested place to make changes for your project
CUSTOMISE = "muelectronics-10000-actions"

# Select the addon package for the hardware
PACKAGE = "raspberrypi"

# Select the hardware from the manufacturer
MACHINE = "raspberrypi-cm3"

# Hardware configuration
HARDWARE = "rpi-cm3-v1-full"





# Set default user account
INHERIT += "extrausers"
EXTRA_USERS_PARAMS = "usermod -P qutipi root; "



# Hide Cursor? 1 for yes, 0 for no
HIDE_CURSOR = "1"

# Setup hdmi or none
DISPLAY_TYPE = "hdmi"

# Setup the  RPI LCD
# DISPLAY_TYPE = "rpi7"
# EGLFS_PWIDTH = "155"
# EGLFS_PHEIGHT = "86"

# Custom LCD screen (for example pitft35r 480x320 touchscreen)
# DISPLAY_TYPE = "custom"
# EGLFS_WIDT = "480"
# EGLFS_HEIGHT = "320"
# EGLFS_PWIDTH = "85"
# EGLFS_PHEIGHT = "50"
# TOUCHSCREEN_ADDRESS = "/dev/input/touchscreen0"
# TOUCHSCREEN_ROTATION = "90"




# Mendor settings
MENDER_ARTIFACT_NAME = "release-1"
INHERIT += "mender-full"
RPI_USE_U_BOOT = "1"
MENDER_PARTITION_ALIGNMENT_KB = "4096"
MENDER_BOOT_PART_SIZE_MB = "40"
IMAGE_INSTALL_append = " kernel-image kernel-devicetree"
IMAGE_FSTYPES_remove += " rpi-sdimg"

# Build for Hosted Mender
#
# MENDER_SERVER_URL = "https://hosted.mender.io"
# MENDER_TENANT_TOKEN = "<YOUR-HOSTED-MENDER-TENANT-TOKEN>"



# Where to store the temp build files?
#TMPDIR = "${TOPDIR}/tmp"

# Where to store the downloaded files
#DL_DIR ?= "${TOPDIR}/downloads"

# Where to store the shared state cache
#SSTATE_DIR ?= "${TOPDIR}/downloads"





# The selected distribution 
DISTRO ?= "qutipi"



# SDK target architecture linux 
SDKMACHINE = "x86_64"

# SDK target architecture windows 
#SDKMACHINE = "x86_64-mingw32"
#OE_QMAKE_PLATFORM_NATIVE_mingw32 = "win32-g++-oe"
#OE_QMAKE_PLATFORM_mingw32 = "win32-g++-oe"
#QT_MODULE_BRANCH_PARAM = "nobranch=1"
#PACKAGE_EXCLUDE_COMPLEMENTARY ?= "qtquickcompiler"



# Addtion image feature 
EXTRA_IMAGE_FEATURES = "debug-tweaks"



# Set the number of parrallel task to run for bitbake
# By default this is the number of cores on your PC
# BB_NUMBER_THREADS = ""

# Set the number of cores to use during "do_compile"
# By default this is the number of cores on your PC
# PARALLEL_MAKE = ""



# Track breaking changes to this file
CONF_VERSION = "1"



# Ensure builds fail if cant apply patch
PATCHRESOLVE = "noop"



# Delete temporary workspace during builds
INHERIT += "rm_work"
```
